#include <Arduino.h>
#include <U8g2lib.h> // U8g2 for text plus graphics

U8G2_SSD1306_128X64_NONAME_F_HW_I2C oled{U8G2_R0};

int display_width = 128;
int display_height = 64;

const int vrx_pin = A2;
const int vry_pin = A3;

// up = vrx 1000
// down = vrx 0
// right = vry 0
// left = vry 1000

int joy_y = 0;
int joy_x = 0;

int speed = 3;

int player_x = 64, player_y = 32;
int xvel = 0, yvel = 0;

#define food_width 14
#define food_height 16
const static unsigned char apple_bits[] PROGMEM= {
   0x1c, 0x00, 0xba, 0x00, 0xdc, 0x00, 0x80, 0x00, 0xbc, 0x0f, 0xc2, 0x10,
   0x03, 0x30, 0x07, 0x38, 0x1f, 0x3e, 0xff, 0x3f, 0xff, 0x3f, 0xff, 0x3f,
   0xfe, 0x1f, 0xfe, 0x1f, 0xfc, 0x0f, 0x38, 0x07 };
int food_x = random(1, display_width - food_width - 2);
int food_y = random(1, display_height - food_height - 2);

int points = 0;

long last_flip = millis();
bool idle_state = true;

#define kirb_width 24
#define kirb_height 18
const static unsigned char kirb_idle_1_bits[] PROGMEM = {
   0x00, 0x7e, 0x00, 0x80, 0x81, 0x00, 0x40, 0x00, 0x01, 0x20, 0x00, 0x02,
   0x30, 0x98, 0x03, 0x10, 0x10, 0x07, 0x18, 0x98, 0x0f, 0x0c, 0x98, 0x0d,
   0x02, 0x98, 0x1d, 0x01, 0x06, 0x3e, 0x41, 0x00, 0x3c, 0xe3, 0x61, 0x3e,
   0xfe, 0xff, 0x1f, 0xfc, 0xff, 0x0f, 0xf8, 0xff, 0x1f, 0xdc, 0xff, 0x3f,
   0xfc, 0xef, 0x3f, 0xf8, 0xc7, 0x1f };
const static unsigned char kirb_idle_2_bits[] PROGMEM = {
   0x00, 0x7e, 0x00, 0x80, 0x81, 0x00, 0x40, 0x00, 0x01, 0x20, 0x00, 0x02,
   0x30, 0x00, 0x02, 0x10, 0x98, 0x07, 0x18, 0x10, 0x0f, 0x0c, 0x98, 0x0d,
   0x02, 0x98, 0x1d, 0x01, 0x06, 0x3e, 0x41, 0x00, 0x3c, 0xe3, 0x61, 0x3e,
   0xfe, 0xff, 0x1f, 0xfc, 0xff, 0x0f, 0xf8, 0xff, 0x1f, 0xdc, 0xff, 0x3f,
   0xfc, 0xef, 0x3f, 0xf8, 0xc7, 0x1f };
const static unsigned char kirb_move_1_bits[] PROGMEM = {
   0x00, 0xfc, 0x00, 0x00, 0x03, 0x01, 0x80, 0x00, 0x02, 0x40, 0x00, 0x04,
   0x60, 0x30, 0x07, 0x30, 0x20, 0x0e, 0x1c, 0x30, 0x1f, 0x02, 0x30, 0x7b,
   0x01, 0x30, 0xfb, 0x41, 0x0c, 0xfc, 0xe3, 0x00, 0xf8, 0xfe, 0xf3, 0x7c,
   0xfc, 0xff, 0x3f, 0xc0, 0x7f, 0x0f, 0x80, 0xff, 0x07, 0x00, 0xfe, 0x07,
   0x00, 0xfc, 0x07, 0x00, 0xf0, 0x03 };
const static unsigned char kirb_move_2_bits[] PROGMEM = {
   0x00, 0xfc, 0x00, 0x00, 0x03, 0x01, 0x80, 0x00, 0x02, 0x40, 0x00, 0x04,
   0x60, 0x30, 0x3f, 0x3c, 0x20, 0x7e, 0x02, 0x30, 0xff, 0x01, 0x30, 0xfb,
   0x01, 0x30, 0xfb, 0x43, 0x0c, 0x7c, 0xfe, 0x00, 0x3f, 0xfc, 0xc3, 0x1f,
   0xe0, 0xff, 0x37, 0xf0, 0xff, 0x3f, 0xf8, 0xff, 0x1f, 0xf8, 0xff, 0x0f,
   0xf8, 0xc1, 0x03, 0xf0, 0x01, 0x00 };
const static unsigned char kirb_movel_1_bits[] PROGMEM = {
   0x00, 0x3f, 0x00, 0x80, 0xc0, 0x00, 0x40, 0x00, 0x01, 0x20, 0x00, 0x02,
   0xe0, 0x0c, 0x06, 0x70, 0x04, 0x0c, 0xf8, 0x0c, 0x38, 0xde, 0x0c, 0x40,
   0xdf, 0x0c, 0x80, 0x3f, 0x30, 0x82, 0x1f, 0x00, 0xc7, 0x3e, 0xcf, 0x7f,
   0xfc, 0xff, 0x3f, 0xf0, 0xfe, 0x03, 0xe0, 0xff, 0x01, 0xe0, 0x7f, 0x00,
   0xe0, 0x3f, 0x00, 0xc0, 0x0f, 0x00 };
const static unsigned char kirb_movel_2_bits[] PROGMEM = {
   0x00, 0x3f, 0x00, 0x80, 0xc0, 0x00, 0x40, 0x00, 0x01, 0x20, 0x00, 0x02,
   0xfc, 0x0c, 0x06, 0x7e, 0x04, 0x3c, 0xff, 0x0c, 0x40, 0xdf, 0x0c, 0x80,
   0xdf, 0x0c, 0x80, 0x3e, 0x30, 0xc2, 0xfc, 0x00, 0x7f, 0xf8, 0xc3, 0x3f,
   0xec, 0xff, 0x07, 0xfc, 0xff, 0x0f, 0xf8, 0xff, 0x1f, 0xf0, 0xff, 0x1f,
   0xc0, 0x83, 0x1f, 0x00, 0x80, 0x0f };

void setup(void) {
  Serial.begin(57600);
  oled.begin();
  oled.setFont(u8g2_font_ncenB08_tr);
  randomSeed(analogRead(A0));
}

void loop(void) {
  if(millis() - last_flip > 300) {
    last_flip = millis();
    idle_state = !idle_state;
  }
  joy_y = analogRead(vrx_pin) - 503;
  joy_x = analogRead(vry_pin) - 505;

  xvel = speed * (joy_x / -500);
  yvel = speed * (joy_y / 500);

  // Kirby edge checking
  if(!((player_y > display_height - kirb_height - 1) && (yvel > 0)) && !((player_y < 1) && (yvel < 0))) {
    player_y += yvel;
  }
  if(!((player_x < 1) && (xvel < 0)) && !((player_x > display_width - kirb_width - 1) && (xvel > 0))) {
    player_x += xvel;
  }

  // Kirby eating
  if((player_x < food_x && food_x < player_x + kirb_width) &&
     (player_y < food_y && food_y < player_y + kirb_width)) {
      food_x = random(1, display_width - food_width - 2);
      food_y = random(1, display_height - food_height - 2);
      points ++;
  }

  oled.clearBuffer();
  oled.setCursor(1, 9);
  oled.println(points);
  oled.drawXBMP(food_x, food_y, food_width, food_height, apple_bits);
  if(xvel == 0 && yvel == 0) {
    if(idle_state) {
      oled.drawXBMP(player_x, player_y, kirb_width, kirb_height, kirb_idle_1_bits);
    } else {
      oled.drawXBMP(player_x, player_y, kirb_width, kirb_height, kirb_idle_2_bits);
    }
  } else if (xvel > 0) {
    if(idle_state) {
      oled.drawXBMP(player_x, player_y, kirb_width, kirb_height, kirb_move_1_bits);
    } else {
      oled.drawXBMP(player_x, player_y, kirb_width, kirb_height, kirb_move_2_bits);
    }
  } else {
    if(idle_state) {
      oled.drawXBMP(player_x, player_y, kirb_width, kirb_height, kirb_movel_1_bits);
    } else {
      oled.drawXBMP(player_x, player_y, kirb_width, kirb_height, kirb_movel_2_bits);
    }
  }
  oled.sendBuffer(); // writes to I2C display
}

